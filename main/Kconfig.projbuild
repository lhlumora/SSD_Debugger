## main/Kconfig.projbuild
```kconfig
menu "Example Configuration"

    config EXAMPLE_IPV4
        bool "IPV4"
        default y
        depends on LWIP_IPV4

    config EXAMPLE_IPV6
        bool "IPV6"
        default n
        select EXAMPLE_CONNECT_IPV6

    config EXAMPLE_PORT
        int "Port"
        range 0 65535
        default 3333
        help
            Local port the example server will listen on.

            The TCP server of UART0 uses this port, the servers of UART1 and
            UART2 use the next ports (3334 and 3335 by default).

    config EXAMPLE_UART_BAUD
        int "UART baud rate"
        range 300 921600
        default 115200
        help
            Baud rate of the three UART peripherals (UART0, UART1 and UART2).

            The baud rate can be changed at runtime with the 'uart_baud'
            console command.

    config EXAMPLE_UART0_TX_GPIO
        int "UART0 TX GPIO"
        range 0 48
        default 43
        help
            GPIO the TX signal of UART0 is routed to.

    config EXAMPLE_UART0_RX_GPIO
        int "UART0 RX GPIO"
        range 0 48
        default 44
        help
            GPIO the RX signal of UART0 is routed to.

    config EXAMPLE_UART1_TX_GPIO
        int "UART1 TX GPIO"
        range 0 48
        default 17
        help
            GPIO the TX signal of UART1 is routed to.

    config EXAMPLE_UART1_RX_GPIO
        int "UART1 RX GPIO"
        range 0 48
        default 18
        help
            GPIO the RX signal of UART1 is routed to.

    config EXAMPLE_UART2_TX_GPIO
        int "UART2 TX GPIO"
        range 0 48
        default 15
        help
            GPIO the TX signal of UART2 is routed to.

    config EXAMPLE_UART2_RX_GPIO
        int "UART2 RX GPIO"
        range 0 48
        default 16
        help
            GPIO the RX signal of UART2 is routed to.

            Note: the GPIOs 0, 3, 45 and 46 are strapping pins of the
            ESP32-S3, they should not be used by the UARTs. The GPIOs can be
            changed at runtime with the 'uart_pins' console command.

    config EXAMPLE_KEEPALIVE_IDLE
        int "TCP keep-alive idle time(s)"
        default 5
        help
            Keep-alive idle time. In idle time without receiving any data from peer, will send keep-alive probe packet

    config EXAMPLE_KEEPALIVE_INTERVAL
        int "TCP keep-alive interval time(s)"
        default 5
        help
            Keep-alive probe packet interval time.

    config EXAMPLE_KEEPALIVE_COUNT
        int "TCP keep-alive packet retry send counts"
        default 3
        help
            Keep-alive probe packet retry count.

    config EXAMPLE_AUTOMATIC_MODE
        bool "Connect and start the server automatically"
        default n
        help
            When enabled, the Wi-Fi connection is established automatically
            (with the SSID/password of the menuconfig) and the TCP server is
            started right away, as in the original example.

            When disabled (default), the Wi-Fi connection and the TCP server
            are not started automatically. The AP is selected and the server
            is started/stopped with the console commands (scan, connect,
            server_start, server_stop).

    config EXAMPLE_LED_GPIO
        int "Status LED GPIO number"
        range -1 48
        default 21
        help
            GPIO the status LED is connected to. The LED is active low: it is
            lit while the pin is driven low.

            The LED shows the state of the system:
              fast blink       the system is starting up
              slow blink       no AP connected
              solid on         connected to an AP
              double blink     the TCP server is running
              rapid blink      error

            Set to -1 to disable the status LED.

    config EXAMPLE_CONSOLE_FORCE_RAW_MODE
        bool "Force the console line editing mode"
        default y
        help
            The ESP-IDF console checks the capabilities of the terminal with
            a DSR query (ESC[5n) and disables line editing and history if the
            answer does not arrive within 500 ms. On USB Serial/JTAG this
            timeout is easily missed (the boot logs are still being flushed
            or the monitor is not attached yet), so the raw mode is forced
            by default.

            Disable this option only if the console is used with a terminal
            that really does not support escape sequences.

    menu "Display (ST7735S)"

        config EXAMPLE_LCD_ENABLE
            bool "Enable the display"
            default y
            help
                Drive the ST7735S display of the board with LVGL. The display
                shows a test screen that checks the driving of the panel: the
                order of the colors, the shades of gray, the animations and
                the position of the visible area in the memory of the
                controller.

        config EXAMPLE_LCD_SPI_HOST
            int "SPI peripheral"
            range 1 3
            default 2
            help
                The SPI peripheral used by the display: 1 (SPI1), 2 (SPI2) or
                3 (SPI3). SPI2 is the general purpose one, it is the only
                free peripheral on the ESP32-S3: the SPI3 is the bus of the
                flash and of the PSRAM.

        config EXAMPLE_LCD_SCLK_GPIO
            int "SCL (SPI clock) GPIO"
            range 0 48
            default 12
            help
                GPIO the SCL signal of the display is connected to.

        config EXAMPLE_LCD_MOSI_GPIO
            int "SDA (SPI data) GPIO"
            range 0 48
            default 11
            help
                GPIO the SDA signal of the display is connected to.

        config EXAMPLE_LCD_CS_GPIO
            int "CS (chip select) GPIO"
            range 0 48
            default 10
            help
                GPIO the CS signal of the display is connected to.

        config EXAMPLE_LCD_DC_GPIO
            int "DC (data/command) GPIO"
            range 0 48
            default 9
            help
                GPIO the DC signal of the display is connected to.

        config EXAMPLE_LCD_RST_GPIO
            int "RES (reset) GPIO"
            range 0 48
            default 8
            help
                GPIO the RES signal of the display is connected to.

        config EXAMPLE_LCD_BL_GPIO
            int "BL (backlight) GPIO"
            range -1 48
            default 7
            help
                GPIO the BL signal of the display is connected to. Set it to
                -1 when the backlight is not controlled by the ESP32.

        config EXAMPLE_LCD_BL_ACTIVE_LOW
            bool "The backlight is lit when the pin is low"
            default n
            help
                Most of the modules switch the backlight on when the pin is
                driven high. Enable this option when the module uses the
                opposite polarity.

        config EXAMPLE_LCD_SPI_CLOCK_HZ
            int "SPI clock (Hz)"
            range 100000 80000000
            default 10000000
            help
                The speed of the SPI bus of the display. The controller
                supports up to 62.5 MHz, but a low speed is safer when the
                module is connected with long wires. The ST7735 modules are
                usually driven at 10 MHz, the TFT_eSPI library uses the same
                speed. The speed can be changed at runtime with the
                'lcd_clock' command.

        config EXAMPLE_LCD_ROTATION
            int "Rotation of the screen"
            range 0 3
            default 0
            help
                The orientation of the screen: 0 and 180 for the portrait
                mode, 90 and 270 for the landscape mode.

        config EXAMPLE_LCD_WIDTH
            int "Width of the visible area"
            range 80 132
            default 128
            help
                Number of pixels of the visible area of the module. It is 80
                for the 0.96 inch modules and 128 for the 1.8 inch ones.

        config EXAMPLE_LCD_HEIGHT
            int "Height of the visible area"
            range 80 162
            default 160
            help
                Number of pixels of the visible area of the module. It is 160
                for the 0.96 inch and for the 1.8 inch modules.

        config EXAMPLE_LCD_INVERT_COLORS
            bool "Invert the colors of the display"
            default n
            help
                The colors of the screen are inverted by the controller. Most
                of the modules need the inversion to be enabled, disable it
                when the colors of your module are inverted.

        config EXAMPLE_LCD_BGR_ORDER
            bool "The colors are in the BGR order"
            default n
            help
                The order of the colors of the pixels sent to the controller.
                Enable it when the red and the blue are swapped on the screen
                (the module works in the BGR order).

        config EXAMPLE_LCD_COL_START
            int "Offset of the first column"
            range 0 52
            default 0
            help
                The controller has 132x162 pixels of memory, the visible area
                of the module is smaller and offset in it.

                The offset depends on the module:
                  0/0   128x160 modules of the RobotLCD type (the default),
                        the ones driven by the TFT_eSPI library with the
                        ST7735_ROBOTLCD setting
                  2/1   128x160 modules with a green tab
                  26/1  80x160 modules with a green tab
                  24/0  80x160 modules with a red tab

                The offset does not depend on the orientation of the screen.
                It can be changed at runtime with the 'lcd_offset' command.

        config EXAMPLE_LCD_ROW_START
            int "Offset of the first row"
            range 0 52
            default 0
            help
                Offset of the first row of the visible area in the memory of
                the controller, see the offset of the first column.

    endmenu
endmenu
```
